## build/conf/bblayers.conf
```bitbake
BBLAYERS ?= " \
    /home/user/Code/Bitbake/Bitbake-SOP/layers/meta-core \
    /home/user/Code/Bitbake/Bitbake-SOP/layers/meta-app \
"
```

## layers/meta-app/conf/layer.conf
```bitbake
BBPATH .= ":${LAYERDIR}"
BBFILES += "${LAYERDIR}/recipes-*/*.bb"
BBFILE_COLLECTIONS += "app"
BBFILE_PATTERN_app = "^${LAYERDIR}/"
BBFILE_PRIORITY_app = "10"
LAYERSERIES_COMPAT_app = "sop"
```

## layers/meta-core/conf/layer.conf
```bitbake
BBPATH .= ":${LAYERDIR}"
BBFILES += "${LAYERDIR}/recipes-*/*.bb"
BBFILE_COLLECTIONS += "core"
BBFILE_PATTERN_core = "^${LAYERDIR}/"
LAYERSERIES_CORENAMES = "sop"
BBFILE_PRIORITY_core = "5"
LAYERSERIES_COMPAT_core = "sop"
```
